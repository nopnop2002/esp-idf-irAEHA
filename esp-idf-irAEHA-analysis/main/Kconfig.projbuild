## esp-idf-irAEHA-analysis/main/Kconfig.projbuild
```kconfig
menu "Application Configuration"

	config EXAMPLE_RMT_RX_GPIO
		int "RMT RX GPIO"
		range 1 34
		default 34
		help
			Set the GPIO number used for receiving the RMT signal.
endmenu
```
